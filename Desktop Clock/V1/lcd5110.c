#include <stdio.h>
#include <avr/io.h>
#include <avr/pgmspace.h>
#include <avr/interrupt.h>
#include "lcd5110.h"

/* delay macro function */
#define lcd_delay() int i;for(i=-32000;i<32000;i++)

/* Command type sent to the lcd */
typedef enum { LCD_CMD  = 0, LCD_DATA = 1 } LcdCmdData;

/* Function prototypes */
void lcd_base_addr(unsigned int addr);
void lcd_send(unsigned char data, LcdCmdData cd);

/* The lcd cursor position */
int lcdCacheIdx;

/* Alphabet lookup */
const unsigned char PROGMEM font5x7 [][5] = {
	{ 0x00, 0x00, 0x00, 0x00, 0x00 },   // sp
    { 0x00, 0x00, 0x2f, 0x00, 0x00 },   // !
    { 0x00, 0x07, 0x00, 0x07, 0x00 },   // "
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    { 0x44, 0x64, 0x54, 0x4C, 0x44 }   // z
};
const unsigned char PROGMEM weekDays [][10] = {
	{0x00,0x7e,0x02,0x02,0x7e,0x00,0x78,0x10,0x78,0x00},   // Пн
	{0x00,0x7e,0x52,0x56,0x3c,0x00,0x08,0x78,0x08,0x00},   // Вт
	{0x00,0x3c,0x42,0x42,0x24,0x00,0x78,0x28,0x38,0x00},   // Ср
	{0x00,0x0e,0x10,0x10,0x7e,0x00,0x08,0x78,0x08,0x00},   // Чт
	{0x00,0x7e,0x02,0x02,0x7e,0x00,0x08,0x78,0x08,0x00},   // Пт
	{0x00,0x3c,0x42,0x42,0x24,0x00,0x7c,0x54,0x74,0x00},   // Сб
	{0x00,0x7e,0x52,0x56,0x3c,0x00,0x78,0x48,0x48,0x00}   // Вс
};
const unsigned char PROGMEM font15x16 [][15] = {
{0x00,0xc0,0xe0,0x30,0x18,0xc,0xc,0x6,0x6,0x6,0x6,0xc,0x1c,0xf8,0xf0}, //0
{0x00,0x00,0x20,0x30,0x10,0x18,0x8,0xfc,0x3e,0x6,0x00,0x00,0x00,0x00,0x00}, //1
{0x00,0x00,0x18,0x18,0xc,0xc,0x6,0x6,0x6,0x8e,0xfc,0x38,0x00,0x00,0x00}, //2
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{0x00,0x00,0x00,0xe0,0xf0,0x18,0xc,0xc,0x86,0x86,0xc6,0xfe,0x3c,0x00,0x00} //9
};
const unsigned char PROGMEM font15x16bottom [][15] = {
{0x1f,0x3f,0x70,0x60,0x60,0x60,0x60,0x30,0x30,0x18,0x1c,0xe,0x7,0x3,0x1}, //0
{0x00,0x60,0x60,0x60,0x60,0x20,0x7e,0x7f,0x30,0x30,0x10,0x18,0x18,0x18,0x00}, //1
{0xc0,0xe0,0x70,0x70,0x38,0x38,0x34,0x36,0x33,0x31,0x30,0x30,0x30,0x30,0x00}, //2
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{0x00,0x00,0x00,0x00,0x1,0x1,0x1,0x1,0x1,0x78,0x7f,0x3,0x00,0x00,0x00} //9
};

/* Performs IO & LCD controller initialization */
void lcd_init(void){
    // Pull-up on reset pin
    LCD_PORT |= LCD_RST_PIN;
	// Set output bits on lcd port
	LCD_DDR |= LCD_RST_PIN | LCD_SCE_PIN | LCD_DC_PIN | LCD_DATA_PIN | LCD_CLK_PIN;
	// Wait after VCC high for reset (max 30ms)
    delay(150);
    // Toggle display reset pin
    LCD_PORT &= ~LCD_RST_PIN;
    lcd_delay();
    LCD_PORT |= LCD_RST_PIN;
    // Disable LCD controller
    LCD_PORT |= LCD_SCE_PIN;
    lcd_send(0x21, LCD_CMD);  // LCD Extended Commands
    lcd_send(0xC8, LCD_CMD);  // Set LCD Vop(Contrast)
    lcd_send(0x06, LCD_CMD);  // Set Temp coefficent
    lcd_send(0x13, LCD_CMD);  // LCD bias mode 1:48
    lcd_send(0x20, LCD_CMD);  // Standard Commands, Horizontal addressing
    lcd_send(0x0C, LCD_CMD);  // LCD in normal mode
    // Clear lcd
    lcd_clear();
	// For using printf
	//fdevopen(lcd_chr, 0);
	lcd_contrast(0x40);
}

/* Set display contrast. Note: No change is visible at ambient temperature */
void lcd_contrast(unsigned char contrast){
	lcd_send(0x21, LCD_CMD);				// LCD Extended Commands
    lcd_send(0x80 | contrast, LCD_CMD);		// Set LCD Vop(Contrast)
    lcd_send(0x20, LCD_CMD);				// LCD std cmds, hori addr mode
}

/* Clears the display */
void lcd_clear(void){
	lcdCacheIdx = 0;
	
	lcd_base_addr(lcdCacheIdx);
	
    // Set the entire cache to zero and write 0s to lcd
	int i;
    for(i=0;i<LCD_CACHE_SIZE;i++) {
		lcd_send(0, LCD_DATA);
    }
	delay(2000);
}

/* Sets cursor location to xy location corresponding to basic font size */
void lcd_goto_xy(unsigned char x, unsigned char y){
    lcdCacheIdx = (x-1)*6 + (y-1)*84;
}

/* Sets cursor location to exact xy pixel location on the lcd */
void lcd_goto_xy_exact(unsigned char x, unsigned char y){
    lcdCacheIdx = (x-1) + (y-1)*84;
}

/* Displays a character at current cursor location */
void lcd_chr(char chr){
	lcd_base_addr(lcdCacheIdx);
	// 5 pixel wide characters and add space
	unsigned char i;
	for(i=0;i<5;i++){
		lcd_send(pgm_read_byte(&font5x7[chr-32][i]) << 1, LCD_DATA);
	}
	lcd_send(0, LCD_DATA);
	lcdCacheIdx += 6;
}
void lcd_chrNum(char chr,unsigned char x,unsigned char y){
	lcd_goto_xy_exact(x,y);lcd_base_addr(lcdCacheIdx);
	unsigned char i;
	//for(i=0;i<15;i++){lcd_send(pgm_read_byte(&font15x16[chr][i])<<1,LCD_DATA);}
	for(i=0;i<15;i++){lcd_send(pgm_read_byte(&font15x16[chr][i]),LCD_DATA);}
	lcd_goto_xy_exact(x,y+1);lcd_base_addr(lcdCacheIdx);
	for(i=0;i<15;i++){lcd_send(pgm_read_byte(&font15x16bottom[chr][i]),LCD_DATA);}
}
void lcd_chrWD(char chr,unsigned char x,unsigned char y){
	lcd_goto_xy_exact(x,y);lcd_base_addr(lcdCacheIdx);
	unsigned char i;
	for(i=0;i<10;i++){lcd_send(pgm_read_byte(&weekDays[chr-1][i]),LCD_DATA);}
	lcd_goto_xy_exact(x,y+1);lcd_base_addr(lcdCacheIdx);
	lcdCacheIdx+=12;
}
/* Displays string at current cursor location and increment cursor location */
void lcd_str(char *str){
    while(*str){lcd_chr(*str++);}
}

// Set the base address of the lcd
void lcd_base_addr(unsigned int addr) {
	lcd_send(0x80 |(addr % LCD_X_RES), LCD_CMD);
	lcd_send(0x40 |(addr / LCD_X_RES), LCD_CMD);
}

/* Sends data to display controller */
void lcd_send(unsigned char data, LcdCmdData cd){
	// Data/DC are outputs for the lcd (all low)
	LCD_DDR |= LCD_DATA_PIN | LCD_DC_PIN;
	
    // Enable display controller (active low)
    LCD_PORT &= ~LCD_SCE_PIN;

    // Either command or data
    if(cd == LCD_DATA) {
        LCD_PORT |= LCD_DC_PIN;
    } else {
        LCD_PORT &= ~LCD_DC_PIN;
    }
	unsigned char i;
	for(i=0;i<8;i++) {
	
		// Set the DATA pin value
		if((data>>(7-i)) & 0x01) {
			LCD_PORT |= LCD_DATA_PIN;
		} else {
			LCD_PORT &= ~LCD_DATA_PIN;
		}
		
		// Toggle the clock
		LCD_PORT |= LCD_CLK_PIN;
		LCD_PORT &= ~LCD_CLK_PIN;
	}

	// Disable display controller
    LCD_PORT |= LCD_SCE_PIN;
	
	// Data/DC can be used as button inputs when not sending to LCD (/w pullups)
	LCD_DDR &= ~(LCD_DATA_PIN | LCD_DC_PIN);
	LCD_PORT |= LCD_DATA_PIN | LCD_DC_PIN;
}

